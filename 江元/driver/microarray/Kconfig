## 江元/driver/microarray/Kconfig
```kconfig
# Copyright (C) MicroArray  
# MicroArray Fprint Driver Code
# Kconfig
# Date: 2017-3-15
# Version: v4.0.06
# Author: guq
# Contact: guq@microarray.com.cn

config MTK_FINGERPRINT_MICROARRAY_A116N
	bool "(microarray a116n fingerprint sensor)  for MICROARRAY"
	default n
	help
	It support different type sensor
	in this platform. If this option
	is set, it will support fingerprint a116n sensor .
```
